## Kconfig
```kconfig
menu "Autopilot Config"
    choice
        prompt "Select Aircraft Model" 
        default MODEL_SELECT_FIXWING

        config MODEL_SELECT_FIXWING
            bool "Aircraft Model select fixwing"


        config MODEL_SELECT_MC
            bool "Aircraft Model select multicopter"


    endchoice  
    choice
        prompt "Select INS Model"  
        default INS_SELECT_EXT_INS  

        config INS_SELECT_CF_INS
            bool "Complementary Filter"

        config INS_SELECT_PX4_INS
            bool "PX4 EKF"

        config INS_SELECT_EXT_INS
            bool "External INS"

    endchoice  

endmenu
```

## target/sapu-fixwing-template/Kconfig
```kconfig
mainmenu "RT-Thread Configuration"

BSP_DIR := ../../rt-thread/bsp

RTT_DIR := ../../rt-thread
LIB_DIR := ../../rt-thread/bsp/stm32/libraries
PKGS_DIR := packages

source "$(RTT_DIR)/Kconfig"
osource "$PKGS_DIR/Kconfig"
rsource "$(LIB_DIR)/Kconfig"
rsource "board/Kconfig"
rsource "../../Kconfig"
```

## target/sapu-fixwing-template/board/Kconfig
```kconfig
menu "Hardware Drivers Config"

config SOC_STM32H743II
    bool
    select SOC_SERIES_STM32H7
    select RT_USING_COMPONENTS_INIT
    select RT_USING_USER_MAIN
    default y

menu "Onboard Peripheral Drivers"

endmenu

menu "On-chip Peripheral Drivers"
    config ADD_ALL_STM32_HAL
        bool "add all stm32 hal library"
        default y
        
    config BSP_USING_GPIO
        bool "Enable GPIO"
        select RT_USING_PIN
        default y

    config BSP_USING_UART
        bool "Enable UART"
        default y
        select RT_USING_SERIAL

    config BSP_USING_I2C1
        bool "Enable software i2c1 PA.0 PA.1"
        default y
    
    config BSP_USING_SPI1
        bool "Enable SPI1"
            default y

    config BSP_USING_SPI3
        bool "Enable SPI3"
            default y

    config BSP_USING_PWM
        bool "Enable PWM"
            default y

    config BSP_USING_FDCAN1
        bool "Enable FDCAN1"
            default y

    source "$(LIB_DIR)/HAL_Drivers/drivers/Kconfig"

endmenu

menu "Board extended module Drivers"

endmenu

endmenu
```
